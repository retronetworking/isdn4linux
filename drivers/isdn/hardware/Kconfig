## drivers/isdn/hardware/Kconfig
```kconfig
#
# ISDN hardware drivers
#
comment "CAPI hardware drivers"
	depends on NET && ISDN_BOOL && ISDN_CAPI

source "drivers/isdn/hardware/avm/Kconfig"

source "drivers/isdn/hardware/eicon/Kconfig"

# source "drivers/isdn/hardware/mISDN/Kconfig"
```
